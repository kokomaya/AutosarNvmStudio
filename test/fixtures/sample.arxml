AUTOSAR XML
nvm block BlockA: start-offset=0, size=16
nvm block BlockB: start-offset=64, size=32
